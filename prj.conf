## prj.conf
```kconfig
# Copyright 2019 The TensorFlow Authors. All Rights Reserved.
#
# Licensed under the Apache License, Version 2.0 (the "License");
# you may not use this file except in compliance with the License.
# You may obtain a copy of the License at
#
#    http://www.apache.org/licenses/LICENSE-2.0
#
# Unless required by applicable law or agreed to in writing, software
# distributed under the License is distributed on an "AS IS" BASIS,
# WITHOUT WARRANTIES OR CONDITIONS OF ANY KIND, either express or implied.
# See the License for the specific language governing permissions and
# limitations under the License.
# ==============================================================================

CONFIG_SYSTEM_WORKQUEUE_STACK_SIZE=2048
CONFIG_SETTINGS=y

CONFIG_CPP=y
CONFIG_STD_CPP17=y
CONFIG_REQUIRES_FLOAT_PRINTF=y
CONFIG_SENSOR=y

CONFIG_TENSORFLOW_LITE_MICRO=y
CONFIG_SERIAL=y
CONFIG_USE_SEGGER_RTT=y
CONFIG_DEBUG_THREAD_INFO=y
CONFIG_LOG=y
CONFIG_LOG_BACKEND_RTT=y
CONFIG_RTT_CONSOLE=y
CONFIG_CBPRINTF_FP_SUPPORT=y

CONFIG_BT=y
CONFIG_BT_SMP=y
CONFIG_BT_PERIPHERAL=y
CONFIG_BT_SETTINGS=y

CONFIG_BT_DIS=y
CONFIG_BT_ATT_PREPARE_COUNT=5
CONFIG_BT_BAS=y
CONFIG_BT_PRIVACY=y

CONFIG_BT_DEVICE_NAME="GESTURE"
CONFIG_BT_DEVICE_APPEARANCE=833
CONFIG_BT_DEVICE_NAME_DYNAMIC=y
CONFIG_BT_DEVICE_NAME_MAX=65

CONFIG_STDOUT_CONSOLE=y
CONFIG_PRINTK=y
CONFIG_ASSERT=y

CONFIG_FLASH=y
CONFIG_STREAM_FLASH=y
CONFIG_FLASH_PAGE_LAYOUT=y
CONFIG_FLASH_MAP=y

CONFIG_NVS=y
```

## boards/arduino_nano_33_ble.overlay
```dts
/ {
    aliases {
        accel0 = &lis2dh12;
    };
};
```

## boards/thingy52_nrf52832.overlay
```dts
/ {
    aliases {
        accel0 = &lis2dh12;
        sw0 = &button0;
    };
};
```

## src/main.c
```c
/*
 * Copyright 2019 The TensorFlow Authors. All Rights Reserved.
 *
 * Licensed under the Apache License, Version 2.0 (the "License");
 * you may not use this file except in compliance with the License.
 * You may obtain a copy of the License at
 *
 *     http://www.apache.org/licenses/LICENSE-2.0
 *
 * Unless required by applicable law or agreed to in writing, software
 * distributed under the License is distributed on an "AS IS" BASIS,
 * WITHOUT WARRANTIES OR CONDITIONS OF ANY KIND, either express or implied.
 * See the License for the specific language governing permissions and
 * limitations under the License.
 */
#include <zephyr/logging/log.h>

#include "accelerometer.h"
#include "gesture_predictor.h"
#include "bluetooth.h"

/* This is the default main used on systems that have the standard C entry
 * point. Other devices (for example FreeRTOS or ESP32) that have different
 * requirements for entry code (like an app_main function) should specialize
 * this main.cc file in a target-specific subfolder.
 */
int main(void)
{
    int err = 0;
    err = predictor_init();
    if(err){
        printk("Erro na inicialização do sistema\n");
    }

//    err = bluetooth_ready();
    if(err){
        printk("Erro na inicialização do sistema\n");
    }
}
```

## src/accelerometer.c
```c
#include "accelerometer.h"

#define ACCELEROMETER_NODE DT_ALIAS(accel0)

#define BUFLEN 150
int begin_index = 0;
const struct device *const sensor = DEVICE_DT_GET(ACCELEROMETER_NODE);
int current_index = 0;

float bufx[BUFLEN] = { 0.0f };
float bufy[BUFLEN] = { 0.0f };
float bufz[BUFLEN] = { 0.0f };

bool initial = true;


#define ALPHA 0.9f
static float leitura_anterior[3] = {0.0};

float filtroPassaAlta(float leitura_atual, int eixo) {
    return ALPHA * leitura_anterior[eixo] + (1 - ALPHA) * leitura_atual;
}

int accelerometer_config()
{
    if (!device_is_ready(sensor)) {
        printk("%s: device not ready.\n", sensor->name);
        return -EACCES;
    }

    if (sensor == NULL) {
        printk("Failed to get accelerometer, name: %s\n",
                    sensor->name);
    } else {
        printk("Got accelerometer, name: %s\n",
                    sensor->name);
    }
    return 0;
}

bool accelerometer_read(float *input, int length)
{
    int rc;
    struct sensor_value accel[3];
    double acc_x, acc_y, acc_z;
    int samples_count;

    rc = sensor_sample_fetch(sensor);
    if (rc < 0) {
        printk("Fetch failed\n");
        return false;
    }
    /* Skip if there is no data */
    if (rc) {
        return false;
    }

    rc = sensor_channel_get(sensor, SENSOR_CHAN_ACCEL_XYZ, accel);
    if (rc < 0) {
        printk("ERROR: Update failed: %d\n", rc);
        return false;
    }

    acc_x = sensor_value_to_float(&accel[0]);
    acc_y = sensor_value_to_float(&accel[1]);
    acc_z = sensor_value_to_float(&accel[2]);

//    acc_x = (double) filtroPassaAlta((float )acc_x, 0);
//    acc_y = (double) filtroPassaAlta((float )acc_y, 1);
//    acc_z = (double) filtroPassaAlta((float )acc_z, 2);


    input[0] = (float ) acc_x ;
    input[1] = (float ) acc_y ;
    input[2] = (float ) acc_z;

    return true;
}
```

## src/accelerometer.h
```c
#ifndef TENSORFLOW_MAGIC_WAND_ACCELEROMETER_H
#define TENSORFLOW_MAGIC_WAND_ACCELEROMETER_H

#include <zephyr/dsp/types.h>

#include <zephyr/device.h>
#include <zephyr/drivers/sensor.h>
#include <string.h>
#include <zephyr/kernel.h>

int accelerometer_config();

bool accelerometer_read(float *input, int length);

#endif //TENSORFLOW_MAGIC_WAND_ACCELEROMETER_H
```

## src/accelerometer_handler.cpp
```c
/*
 * Copyright 2019 The TensorFlow Authors. All Rights Reserved.
 *
 * Licensed under the Apache License, Version 2.0 (the "License");
 * you may not use this file except in compliance with the License.
 * You may obtain a copy of the License at
 *
 *     http://www.apache.org/licenses/LICENSE-2.0
 *
 * Unless required by applicable law or agreed to in writing, software
 * distributed under the License is distributed on an "AS IS" BASIS,
 * WITHOUT WARRANTIES OR CONDITIONS OF ANY KIND, either express or implied.
 * See the License for the specific language governing permissions and
 * limitations under the License.
 */

#include "accelerometer_handler.hpp"

#include <zephyr/device.h>
#include <zephyr/drivers/sensor.h>
#include <string.h>
#include <zephyr/kernel.h>
#define ACCELEROMETER_NODE DT_ALIAS(accel0)

#define BUFLEN 150
int begin_index = 0;
const struct device *const sensor = DEVICE_DT_GET(ACCELEROMETER_NODE);
int current_index = 0;

float bufx[BUFLEN] = { 0.0f };
float bufy[BUFLEN] = { 0.0f };
float bufz[BUFLEN] = { 0.0f };

bool initial = true;

TfLiteStatus SetupAccelerometer()
{
	if (!device_is_ready(sensor)) {
		printk("%s: device not ready.\n", sensor->name);
		return kTfLiteApplicationError;
	}

	if (sensor == NULL) {
		MicroPrintf("Failed to get accelerometer, name: %s\n",
				    sensor->name);
	} else {
		MicroPrintf("Got accelerometer, name: %s\n",
				    sensor->name);
	}
	return kTfLiteOk;
}

bool ReadAccelerometer(float *input, int length)
{
	int rc;
	struct sensor_value accel[3];
	int samples_count;

	rc = sensor_sample_fetch(sensor);
	if (rc < 0) {
		MicroPrintf("Fetch failed\n");
		return false;
	}
	/* Skip if there is no data */
	if (rc) {
		return false;
	}

	samples_count = 100;
	for (int i = 0; i < samples_count; i++) {
		rc = sensor_channel_get(sensor, SENSOR_CHAN_ACCEL_XYZ, accel);
		if (rc < 0) {
			MicroPrintf("ERROR: Update failed: %d\n", rc);
			return false;
		}
		bufx[begin_index] = (float)sensor_value_to_double(&accel[0]);
		bufy[begin_index] = (float)sensor_value_to_double(&accel[1]);
		bufz[begin_index] = (float)sensor_value_to_double(&accel[2]);
		begin_index++;
		if (begin_index >= BUFLEN) {
			begin_index = 0;
		}
	}

	if (initial && begin_index >= 100) {
		initial = false;
	}

	if (initial) {
		return false;
	}

	int sample = 0;
	for (int i = 0; i < (length - 3); i += 3) {
		int ring_index = begin_index + sample - length / 3;
		if (ring_index < 0) {
			ring_index += BUFLEN;
		}
		input[i] = bufx[ring_index];
		input[i + 1] = bufy[ring_index];
		input[i + 2] = bufz[ring_index];
		sample++;
	}
	return true;
}
```

## src/accelerometer_handler.hpp
```c
/*
 * Copyright 2019 The TensorFlow Authors. All Rights Reserved.
 *
 * Licensed under the Apache License, Version 2.0 (the "License");
 * you may not use this file except in compliance with the License.
 * You may obtain a copy of the License at
 *
 *     http://www.apache.org/licenses/LICENSE-2.0
 *
 * Unless required by applicable law or agreed to in writing, software
 * distributed under the License is distributed on an "AS IS" BASIS,
 * WITHOUT WARRANTIES OR CONDITIONS OF ANY KIND, either express or implied.
 * See the License for the specific language governing permissions and
 * limitations under the License.
 */

#ifndef TENSORFLOW_LITE_MICRO_EXAMPLES_MAGIC_WAND_ACCELEROMETER_HANDLER_H_
#define TENSORFLOW_LITE_MICRO_EXAMPLES_MAGIC_WAND_ACCELEROMETER_HANDLER_H_

#define kChannelNumber 3

#include <tensorflow/lite/c/c_api_types.h>
#include <tensorflow/lite/micro/micro_log.h>
#include <zephyr/dsp/types.h>

extern int begin_index;
extern TfLiteStatus SetupAccelerometer();
extern bool ReadAccelerometer(float *input, int length);

#endif /* TENSORFLOW_LITE_MICRO_EXAMPLES_MAGIC_WAND_ACCELEROMETER_HANDLER_H_ */
```

## src/bluetooth.c
```c
//
// Created by jose on 06/03/24.
//

#include "bluetooth.h"

#include <zephyr/bluetooth/bluetooth.h>
#include <zephyr/bluetooth/conn.h>
#include <zephyr/bluetooth/uuid.h>
#include <zephyr/bluetooth/gatt.h>
#include <zephyr/settings/settings.h>

static ssize_t read_channels(struct bt_conn *conn, const struct bt_gatt_attr *attr,
                             void *buf, uint16_t len, uint16_t offset);

static ssize_t write_channels(struct bt_conn *conn, const struct bt_gatt_attr *attr,
                              const void *buf, uint16_t len, uint16_t offset,
                              uint8_t flags);

static void connected(struct bt_conn *conn, uint8_t err);

static void disconnected(struct bt_conn *conn, uint8_t reason);

static struct {
    struct {
        struct k_msgq periheral_menssage_ble;
        char __aligned(4) msgq_buffer[10 * sizeof(data_t)];
    };
    struct bt_gatt_exchange_params exchange_params;
    struct bt_conn_cb conn_callbacks;
    struct bt_conn *default_conn;
    data_t data_e;

} self = {
        .data_e = {0},
        .conn_callbacks = {
                .connected    = connected,
                .disconnected = disconnected,
        },
        .default_conn = NULL,
};

void ble_peripheral_cfg_changed(const struct bt_gatt_attr *attr, uint16_t value) {
    ARG_UNUSED(attr);
    bool notify_enabled = (value == BT_GATT_CCC_NOTIFY);
    printk("NOTIFY %s.\n",(notify_enabled ? "enabled" : "disabled"));
}

static ssize_t write_channels(struct bt_conn *conn, const struct bt_gatt_attr *attr,
                              const void *buf, uint16_t len, uint16_t offset,
                              uint8_t flags)
{
    static data_t data;
    data.len = len;
    memcpy(data.data, buf, len);
    k_msgq_put(&self.periheral_menssage_ble, &data, K_NO_WAIT);

    return len;
}
static const struct bt_data ad[] = {
        BT_DATA_BYTES(BT_DATA_FLAGS,(BT_LE_AD_GENERAL | BT_LE_AD_NO_BREDR)),
        BT_DATA_BYTES(BT_DATA_UUID16_ALL,BT_UUID_16_ENCODE(0xf1),),
};

BT_GATT_SERVICE_DEFINE(
        peripheral_service, BT_GATT_PRIMARY_SERVICE(SERVICE_UUID),
        BT_GATT_CHARACTERISTIC(WHITE_CARAC, BT_GATT_CHRC_WRITE, BT_GATT_PERM_WRITE, NULL,
                               write_channels, NULL),
        BT_GATT_CHARACTERISTIC(NOTIFY_CARAC, BT_GATT_CHRC_READ |BT_GATT_CHRC_NOTIFY,
                               BT_GATT_PERM_NONE, NULL, NULL, NULL),
        BT_GATT_CCC(ble_peripheral_cfg_changed, BT_GATT_PERM_READ | BT_GATT_PERM_WRITE),);


static void exchange_func(struct bt_conn *conn, uint8_t err,
                          struct bt_gatt_exchange_params *params)
{
    if (!err) {
        uint16_t mtu = bt_gatt_get_mtu(conn);
        printk("New MTU is %d", mtu);
    }
}

static void connected(struct bt_conn *conn, uint8_t err)
{
    if (err) {
        printk("Connection failed (err 0x%02x)\n", err);
    } else {
        printk("Connected\n");
        self.default_conn = bt_conn_ref(conn);
        self.exchange_params.func = exchange_func;
    }
}

static void disconnected(struct bt_conn *conn, uint8_t reason)
{
    int err;
    printk("Disconnected (reason 0x%02x)\n", reason);

    if (self.default_conn) {
        bt_conn_unref(self.default_conn);
        self.default_conn = NULL;
    }

    err = bt_le_adv_start(BT_LE_ADV_CONN_NAME, ad, ARRAY_SIZE(ad), NULL, 0);
    if (err) {
        printk("Falha ao iniciar o Advertising. (err %d).\n", err);
    }
}

static struct bt_conn_cb conn_callbacks = {
        .connected    = connected,
        .disconnected = disconnected,
};


int bluetooth_ready(void)
{
    int err;

    err = bt_enable(NULL);
    if (err) {
        printk("Bluetooth init failed (err %d)\n", err);
        return -EBUSY;
    }

    k_msgq_init(&self.periheral_menssage_ble, self.msgq_buffer, sizeof(data_t), 10);
    if (IS_ENABLED(CONFIG_SETTINGS)) {
        settings_load();
    }

    printk("Bluetooth initialized\n");

    err = bt_le_adv_start(BT_LE_ADV_CONN_NAME, ad, ARRAY_SIZE(ad), NULL, 0);
    if (err) {
        printk("Advertising failed to start (err %d)\n", err);
        return -EBUSY;
    }

    bt_conn_cb_register(&conn_callbacks);

    printk("Advertising successfully started\n");

    return 0;
}

int bluetooth_send_notify(uint8_t* data, uint16_t len){

    int err = 0;
    data_t data_copy = {0};

    if(data == NULL){
        return -1;
    }
    memcpy(data_copy.data, data, len);
    data_copy.len = len;

    err = k_msgq_put(&self.periheral_menssage_ble, &data_copy, K_NO_WAIT);

    return err;
}

void bluetooth_task(void){
    int err;
    data_t data = {0};
    k_sleep(K_MSEC(5000));
    while (true){
        k_msgq_get(&self.periheral_menssage_ble, &data, K_FOREVER);

        err = bt_gatt_notify(NULL, &peripheral_service.attrs[3], data.data, data.len);
        if (err) {
            printk("ERRO AO NOTIFICAR.\n");
        }
    }
}

K_THREAD_DEFINE(bluetooth_task_id, 1024,
                bluetooth_task, NULL, NULL, NULL, 5, 0, 1000);
```

## src/bluetooth.h
```c
//
// Created by jose on 06/03/24.
//

#ifndef TENSORFLOW_MAGIC_WAND_BLUETOOTH_H
#define TENSORFLOW_MAGIC_WAND_BLUETOOTH_H

#include <zephyr/kernel.h>
#include <stddef.h>
#include <string.h>
#include <zephyr/sys/printk.h>
#include <zephyr/settings/settings.h>

#define SERVICE_UUID BT_UUID_DECLARE_16(0xf1)

#define WHITE_CARAC BT_UUID_DECLARE_16(0xf2)

#define NOTIFY_CARAC BT_UUID_DECLARE_16(0xf3)


typedef struct
{
    uint8_t data[64];
    uint16_t len;
} data_t;


int bluetooth_ready(void);

int bluetooth_send_notify(uint8_t* data, uint16_t len);
#endif //TENSORFLOW_MAGIC_WAND_BLUETOOTH_H
```

## src/constants.hpp
```c
/*
 * Copyright 2019 The TensorFlow Authors. All Rights Reserved.
 *
 * Licensed under the Apache License, Version 2.0 (the "License");
 * you may not use this file except in compliance with the License.
 * You may obtain a copy of the License at
 *
 *     http://www.apache.org/licenses/LICENSE-2.0
 *
 * Unless required by applicable law or agreed to in writing, software
 * distributed under the License is distributed on an "AS IS" BASIS,
 * WITHOUT WARRANTIES OR CONDITIONS OF ANY KIND, either express or implied.
 * See the License for the specific language governing permissions and
 * limitations under the License.
 */

#ifndef TENSORFLOW_LITE_MICRO_EXAMPLES_MAGIC_WAND_CONSTANTS_H_
#define TENSORFLOW_LITE_MICRO_EXAMPLES_MAGIC_WAND_CONSTANTS_H_
#include <zephyr/dsp/types.h>

/* The expected accelerometer data sample frequency */
const float kTargetHz = 25;

/* What gestures are supported. */
constexpr int kGestureCount = 3;
constexpr int kWingGesture = 0;
constexpr int kRingGesture = 1;
constexpr int kSlopeGesture = 2;
constexpr int kNoGesture = 3;

/* These control the sensitivity of the detection algorithm. If you're seeing
 * too many false positives or not enough true positives, you can try tweaking
 * these thresholds. Often, increasing the size of the training set will give
 * more robust results though, so consider retraining if you are seeing poor
 * predictions.
 */
constexpr float kDetectionThreshold = 0.6f;
constexpr int kPredictionHistoryLength = 5;
constexpr int kPredictionSuppressionDuration = 25;

#endif /* TENSORFLOW_LITE_MICRO_EXAMPLES_MAGIC_WAND_CONSTANTS_H_ */
```

## src/gesture_predictor.cpp
```c
/*
 * Copyright 2019 The TensorFlow Authors. All Rights Reserved.
 *
 * Licensed under the Apache License, Version 2.0 (the "License");
 * you may not use this file except in compliance with the License.
 * You may obtain a copy of the License at
 *
 *     http://www.apache.org/licenses/LICENSE-2.0
 *
 * Unless required by applicable law or agreed to in writing, software
 * distributed under the License is distributed on an "AS IS" BASIS,
 * WITHOUT WARRANTIES OR CONDITIONS OF ANY KIND, either express or implied.
 * See the License for the specific language governing permissions and
 * limitations under the License.
 */

#include "gesture_predictor.h"

#include <tensorflow/lite/micro/micro_interpreter.h>
#include <tensorflow/lite/micro/micro_mutable_op_resolver.h>
#include <zephyr/logging/log.h>
#include <zephyr/device.h>
#include <zephyr/drivers/gpio.h>

#include "constants.hpp"
#include "magic_wand_model_data.hpp"
#include "output_handler.h"


#define SW0_NODE	DT_ALIAS(sw0)
#if !DT_NODE_HAS_STATUS(SW0_NODE, okay)
#error "Unsupported board: sw0 devicetree alias is not defined"
#endif
static const struct gpio_dt_spec button = GPIO_DT_SPEC_GET_OR(SW0_NODE, gpios,
                                                              {0});
static struct gpio_callback button_cb_data;

#define KTENSOR_ARENA_SIZE (10 * 1024)

#ifdef __cplusplus
extern "C" {
#endif

static struct {
    const tflite::Model *model;
    tflite::MicroInterpreter *interpreter;
    TfLiteTensor *model_input;
    int input_length;
    size_t n_classes;
    TfLiteTensor* output_tensor;

    uint8_t tensor_arena[KTENSOR_ARENA_SIZE];

    float prediction_history[kGestureCount][kPredictionHistoryLength];
    int prediction_history_index;
    int prediction_suppression_count;
} self = {
        .model = nullptr,
        .interpreter = nullptr,
        .model_input = nullptr,
        .input_length = 0,

        .prediction_history = {{0}},
        .prediction_history_index = 0,
        .prediction_suppression_count = 0,
};

extern const k_tid_t predict_thread_id;

int PredictGesture(const float *output) {

    TfLiteStatus status;
    uint8_t argmax = -1;
    float max = 0.0f;

    argmax = 0;
    max = output[argmax];

    float z, o, v;

    o= output[0];
    v = output[1];
    z = output[2];
    for (uint8_t i = 0; i < self.n_classes; i++) {
        if (output[i] > max) {
            max = output[i];
            argmax = i;
        }
    }

    printk("V: %f, 0:%f, Z:%f/n", v, o, z);
    return argmax;
}

void button_pressed(const struct device *dev, struct gpio_callback *cb,
                    uint32_t pins)
{
    printk("Button pressed at %" PRIu32 "\n", k_cycle_get_32());
}

int init_button(){
    int ret = 0;
    if (!gpio_is_ready_dt(&button)) {
        printk("Error: button device %s is not ready\n",
               button.port->name);
        return -1;
    }

    ret = gpio_pin_configure_dt(&button, GPIO_INPUT);
    if (ret != 0) {
        printk("Error %d: failed to configure %s pin %d\n",
               ret, button.port->name, button.pin);
        return -1;
    }

    ret = gpio_pin_interrupt_configure_dt(&button,
                                          GPIO_INT_EDGE_TO_ACTIVE);
    if (ret != 0) {
        printk("Error %d: failed to configure interrupt on %s pin %d\n",
               ret, button.port->name, button.pin);
        return -1;
    }

    gpio_init_callback(&button_cb_data, button_pressed, BIT(button.pin));
    gpio_add_callback(button.port, &button_cb_data);
    printk("Set up button at %s pin %d\n", button.port->name, button.pin);

    return ret;
}

int predictor_init(void) {

    if(init_button()){
        printk("Button não encontrado\n");
    }
    self.model = tflite::GetModel(g_magic_wand_model_data);
    if (self.model->version() != TFLITE_SCHEMA_VERSION) {
        printk("Model provided is schema version %d not equal "
               "to supported version %d.",
               self.model->version(), TFLITE_SCHEMA_VERSION);
        return -1;
    }

    static tflite::MicroMutableOpResolver<3> micro_op_resolver = tflite::MicroMutableOpResolver<3>();
    micro_op_resolver.AddReshape();
    micro_op_resolver.AddFullyConnected();
    micro_op_resolver.AddSoftmax();

    static tflite::MicroInterpreter static_interpreter = tflite::MicroInterpreter(
            self.model, micro_op_resolver, self.tensor_arena, KTENSOR_ARENA_SIZE);
    self.interpreter = &static_interpreter;

    TfLiteStatus status = self.interpreter->AllocateTensors();

    self.model_input = self.interpreter->input(0);
    self.output_tensor = self.interpreter->output_tensor(0);
    if (status != kTfLiteOk) {
        printk("Bad input tensor parameters in model");
        return -1;
    }

    self.input_length = self.model_input->bytes / (3 * sizeof(float));
    self.n_classes = self.output_tensor->bytes / sizeof(float);

    int setup_status = accelerometer_config();
    if (setup_status) {
        printk("Set up failed Acceleremeter\n");
        return -1;
    }
    return 0;
}

void predict_thread(void) {
    uint16_t count_sample = 0;
    k_sleep(K_MSEC(5000));
    while (true) {
        int val = gpio_pin_get_dt(&button);

        if (!val) {
            count_sample = 0;
            for (int i = 0; i < 3 * self.input_length; i++) {
                self.model_input->data.f[i] = 0.0f;
            }
            k_sleep(K_MSEC(10));
            continue;
        }

        bool got_data =
                accelerometer_read(self.model_input->data.f + 3 * count_sample, self.input_length);
        if (!got_data) {
            return;
        }
        count_sample ++;
        if(count_sample < self.input_length){
            k_sleep(K_MSEC(10));
            continue;
        }

        TfLiteStatus invoke_status = self.interpreter->Invoke();
        if (invoke_status != kTfLiteOk) {
            printk("Invoke failed on index\n");
            return;
        }
        int gesture_index = PredictGesture(self.interpreter->output(0)->data.f);

        classificatiopn_predict(gesture_index);

        count_sample = 0;
        for (int i = 0; i < 3 * self.input_length; i++) {
            self.model_input->data.f[i] = 0.0f;
        }
        k_sleep(K_MSEC(10));
    }
}

K_THREAD_DEFINE(predict_thread_id, 2048,
                predict_thread, NULL, NULL, NULL, 5, 0, 1000);

#ifdef __cplusplus
};
#endif
```

## src/gesture_predictor.h
```c
/*
 * Copyright 2019 The TensorFlow Authors. All Rights Reserved.
 *
 * Licensed under the Apache License, Version 2.0 (the "License");
 * you may not use this file except in compliance with the License.
 * You may obtain a copy of the License at
 *
 *     http://www.apache.org/licenses/LICENSE-2.0
 *
 * Unless required by applicable law or agreed to in writing, software
 * distributed under the License is distributed on an "AS IS" BASIS,
 * WITHOUT WARRANTIES OR CONDITIONS OF ANY KIND, either express or implied.
 * See the License for the specific language governing permissions and
 * limitations under the License.
 */

#ifndef TENSORFLOW_LITE_MICRO_EXAMPLES_MAGIC_WAND_GESTURE_PREDICTOR_H_
#define TENSORFLOW_LITE_MICRO_EXAMPLES_MAGIC_WAND_GESTURE_PREDICTOR_H_

#ifdef __cplusplus
extern "C" {
#endif

#include <zephyr/dsp/types.h>
#include <zephyr/kernel.h>

#include "accelerometer.h"
#include "output_handler.h"

int PredictGesture(const float *output);

int predictor_init(void);

void predict_thread(void);

#ifdef __cplusplus
};
#endif

#endif /* TENSORFLOW_LITE_MICRO_EXAMPLES_MAGIC_WAND_GESTURE_PREDICTOR_H_ */
```

## src/gesture_predictor.hpp
```c
/*
 * Copyright 2019 The TensorFlow Authors. All Rights Reserved.
 *
 * Licensed under the Apache License, Version 2.0 (the "License");
 * you may not use this file except in compliance with the License.
 * You may obtain a copy of the License at
 *
 *     http://www.apache.org/licenses/LICENSE-2.0
 *
 * Unless required by applicable law or agreed to in writing, software
 * distributed under the License is distributed on an "AS IS" BASIS,
 * WITHOUT WARRANTIES OR CONDITIONS OF ANY KIND, either express or implied.
 * See the License for the specific language governing permissions and
 * limitations under the License.
 */

#ifndef TENSORFLOW_LITE_MICRO_EXAMPLES_MAGIC_WAND_GESTURE_PREDICTOR_H_
#define TENSORFLOW_LITE_MICRO_EXAMPLES_MAGIC_WAND_GESTURE_PREDICTOR_H_
#include <zephyr/dsp/types.h>

extern int PredictGesture(const float *output);

#endif /* TENSORFLOW_LITE_MICRO_EXAMPLES_MAGIC_WAND_GESTURE_PREDICTOR_H_ */
```

## src/main_functions.cpp
```c
/*
 * Copyright 2019 The TensorFlow Authors. All Rights Reserved.
 *
 * Licensed under the Apache License, Version 2.0 (the "License");
 * you may not use this file except in compliance with the License.
 * You may obtain a copy of the License at
 *
 *     http://www.apache.org/licenses/LICENSE-2.0
 *
 * Unless required by applicable law or agreed to in writing, software
 * distributed under the License is distributed on an "AS IS" BASIS,
 * WITHOUT WARRANTIES OR CONDITIONS OF ANY KIND, either express or implied.
 * See the License for the specific language governing permissions and
 * limitations under the License.
 */

#include "main_functions.hpp"

#include "accelerometer_handler.hpp"
#include "gesture_predictor.hpp"
#include "magic_wand_model_data.hpp"
#include "output_handler.hpp"
#include <tensorflow/lite/micro/micro_interpreter.h>
#include <tensorflow/lite/micro/micro_mutable_op_resolver.h>

/* Globals, used for compatibility with Arduino-style sketches. */
namespace {
	const tflite::Model *model = nullptr;
	tflite::MicroInterpreter *interpreter = nullptr;
	TfLiteTensor *model_input = nullptr;
	int input_length;

	/* Create an area of memory to use for input, output, and intermediate arrays.
	* The size of this will depend on the model you're using, and may need to be
	* determined by experimentation.
	*/
	constexpr int kTensorArenaSize = 45 * 1024;
	uint8_t tensor_arena[kTensorArenaSize];
} /* namespace */

/* The name of this function is important for Arduino compatibility. */
void setup(void)
{
	/* Map the model into a usable data structure. This doesn't involve any
	 * copying or parsing, it's a very lightweight operation.
	 */
	model = tflite::GetModel(g_magic_wand_model_data);
	if (model->version() != TFLITE_SCHEMA_VERSION) {
		MicroPrintf("Model provided is schema version %d not equal "
				    "to supported version %d.",
				    model->version(), TFLITE_SCHEMA_VERSION);
		return;
	}

	/* Pull in only the operation implementations we need.
	 * This relies on a complete list of all the ops needed by this graph.
	 * An easier approach is to just use the AllOpsResolver, but this will
	 * incur some penalty in code space for op implementations that are not
	 * needed by this graph.
	 */
	static tflite::MicroMutableOpResolver < 5 > micro_op_resolver = tflite::MicroMutableOpResolver<5>();
    micro_op_resolver.AddConv2D();
    micro_op_resolver.AddMaxPool2D();
    micro_op_resolver.AddReshape();
    micro_op_resolver.AddFullyConnected();
    micro_op_resolver.AddSoftmax();

	/* Build an interpreter to run the model with. */
	static tflite::MicroInterpreter static_interpreter = tflite::MicroInterpreter(
		model, micro_op_resolver, tensor_arena, kTensorArenaSize);
	interpreter = &static_interpreter;

	/* Allocate memory from the tensor_arena for the model's tensors. */
    TfLiteStatus status = interpreter->AllocateTensors();

	/* Obtain pointer to the model's input tensor. */
	model_input = interpreter->input(0);
	if (status != kTfLiteOk) {
		MicroPrintf("Bad input tensor parameters in model");
		return;
	}

	input_length = model_input->bytes / (3 * sizeof(float));

	TfLiteStatus setup_status = SetupAccelerometer();
	if (setup_status != kTfLiteOk) {
		MicroPrintf("Set up failed\n");
	}
}

void loop(void)
{
	/* Attempt to read new data from the accelerometer. */
	bool got_data =
		ReadAccelerometer(model_input->data.f, input_length);

	/* If there was no new data, wait until next time. */
	if (!got_data) {
		return;
	}

	/* Run inference, and report any error */
	TfLiteStatus invoke_status = interpreter->Invoke();
	if (invoke_status != kTfLiteOk) {
		MicroPrintf("Invoke failed on index: %d\n", begin_index);
		return;
	}
	/* Analyze the results to obtain a prediction */
	int gesture_index = PredictGesture(interpreter->output(0)->data.f);

	/* Produce an output */
	HandleOutput(gesture_index);
}
```
